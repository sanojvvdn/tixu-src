## sources/meta-fsl-arm/conf/machine/imx6sltixu.conf
```bitbake
#@TYPE: Machine
#@NAME: TI i.MX6SL based Evaluation Kit with tps65910 Pmic
#@SOC: i.MX6SL
#@DESCRIPTION: Machine configuration for TI i.MX6SL Evaluation Kit
#@MAINTAINER: Sanoj Kumar <sanoj.kumar@vvdntech.com>

include conf/machine/include/imx-base.inc
include conf/machine/include/tune-cortexa9.inc

SOC_FAMILY = "mx6:mx6sl"

KERNEL_DEVICETREE = "imx6sl-tixu.dtb imx6sl-tixu-ldo.dtb"

UBOOT_CONFIG ??= "sd"
UBOOT_CONFIG[sd] = "mx6sltixu_config,sdcard"
UBOOT_CONFIG[spinor] = "mx6sltixu_spinor_config"
UBOOT_CONFIG[mfgtool] = "mx6sltixu_config"

PREFERRED_PROVIDER_virtual/kernel ?= "linux-imx"
PREFERRED_VERSION_linux-tixu ?= "3.14.38"

SERIAL_CONSOLE = "115200 ttymxc0"

MACHINE_FEATURES += " pci wifi bluetooth"

MACHINE_FIRMWARE += "linux-firmware-ath6k"
```

## sources/meta-vvdn/conf/layer.conf
```bitbake
# We have a conf and classes directory, add to BBPATH
BBPATH .= ":${LAYERDIR}"

# We have recipes-* directories, add to BBFILES
BBFILES += "${LAYERDIR}/recipes-*/*/*.bb \
	${LAYERDIR}/recipes-*/*/*.bbappend"

BBFILE_COLLECTIONS += "vvdn"
BBFILE_PATTERN_vvdn = "^${LAYERDIR}/"
BBFILE_PRIORITY_vvdn = "6"
```
